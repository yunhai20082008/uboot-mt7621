## board/ralink/common/Kconfig
```kconfig
config MTKAUTOBOOT_DELAY
	int "Delay for mtkautoboot command (seconds)"
	range 1 60
	default 3
	help
	  This is the default delay value for mtkautoboot command.
	  It can be overrided by environment variable "mtkautoboot.delay"

config MTK_DUAL_IMAGE_SUPPORT
	bool "Enable dual image support"
	default n
	help
	  Dual image support provides a way to protect the image from being
	  damaged. When enabled, image check will be performed before booting.
	  Both main image and backup image will be checked. If one of them has
	  been damaged, the other one will replace it.

config MTK_DUAL_IMAGE_PARTNAME_MAIN
	string "MTD partition name of the main image"
	default "firmware"
	depends on MTK_DUAL_IMAGE_SUPPORT
	help
	  The MTD partition name of the main image. Normally it will be
	  "firmware", and is the image to be booted.

config MTK_DUAL_IMAGE_PARTNAME_BACKUP
	string "MTD partition name of the backup image"
	default "firmware_backup"
	depends on MTK_DUAL_IMAGE_SUPPORT
	help
	  The MTD partition name of the backup image.

config MTK_DUAL_IMAGE_SQUASHFS_DATA_CHECK
	bool "Check squashfs rootfs integrity"
	default y
	depends on MTK_DUAL_IMAGE_SUPPORT
	help
	  Check the integrity of the squashfs rootfs.
	  Please note that squashfs has no checksum for integrity. This
	  option only checks if the rootfs has non-0xff byte in the last byte,
	  and 0xff for the next byte, which is not always accurate.

config MTK_DUAL_IMAGE_RESTORE_KERNEL_ONLY
	bool "Restore kernel only"
	default n
	depends on MTK_DUAL_IMAGE_SUPPORT
	help
	  If one image is broken, only restore its kernel part/

config ENV_ERASE_UPDATE
	bool "Erase u-boot environment after upgrading u-boot"
	default n
	depends on !ENV_IS_NOWHERE

config MTKAUTOBOOT_NET_RECOVERY
	bool "Enable network web recovery probe in mtkautoboot"
	default n
	depends on NET
	help
	  When enabled, mtkautoboot will ping the host given by env
	  "mtk_recovery_probe" (default "192.168.1.2") after network
	  init. If reachable, U-Boot enters httpd (web recovery mode)
	  instead of continuing to boot the firmware. This allows a
	  recovery client on the network to bring the device into web
	  recovery on power-cycle.
```
